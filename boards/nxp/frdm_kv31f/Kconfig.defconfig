## boards/nxp/frdm_kv31f/Kconfig.defconfig
```kconfig
# FRDM-KV31F board
# SPDX-License-Identifier: Apache-2.0

if BOARD_FRDM_KV31F

config OSC_XTAL0_FREQ
	default 8000000

config MCG_FRDIV
	default 5

config MCG_FCRDIV
	default 0

config FXOS8700_DRDY_INT1
	default y
	depends on FXOS8700_TRIGGER

endif # BOARD_FRDM_KV31F
```

## boards/nxp/frdm_kv31f/board.yml
```yaml
board:
  name: frdm_kv31f
  full_name: FRDM-KV31F
  vendor: nxp
  socs:
    - name: mkv31f512vll12
```
